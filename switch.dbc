VERSION ""

NS_ :

BS_:

BU_:

BO_ 1851 switch_message: 1 Vector__XXX
 SG_ switch_signal : 0|8@1+ (1,0) [0|255] "" Vector__XXX

BA_DEF_  "MultiplexExtEnabled" ENUM  "No","Yes";
BA_DEF_  "BusType" STRING ;
BA_DEF_DEF_  "MultiplexExtEnabled" "No";
BA_DEF_DEF_  "BusType" "CAN";
BA_ "MultiplexExtEnabled" 1;
